## build_net/Kconfig/boards/Kconfig.defconfig
```kconfig
# Load Zephyr board defconfig descriptions.
osource "C:/ncs/v3.2.01/zephyr/boards/nordic/nrf5340dk/Kconfig.defconfig"
```

## build_test/Kconfig/boards/Kconfig
```kconfig
# Load Zephyr board Kconfig descriptions.
osource "C:/ncs/v3.2.01/zephyr/boards/nordic/nrf5340dk/Kconfig"
```

## build_uart/Kconfig/arch/Kconfig
```kconfig
# Load Zephyr Arch Kconfig descriptions.
osource "C:/ncs/v3.2.01/zephyr/arch/rx/Kconfig"
osource "C:/ncs/v3.2.01/zephyr/arch/x86/Kconfig"
osource "C:/ncs/v3.2.01/zephyr/arch/xtensa/Kconfig"
osource "C:/ncs/v3.2.01/zephyr/arch/sparc/Kconfig"
osource "C:/ncs/v3.2.01/zephyr/arch/riscv/Kconfig"
osource "C:/ncs/v3.2.01/zephyr/arch/posix/Kconfig"
osource "C:/ncs/v3.2.01/zephyr/arch/mips/Kconfig"
osource "C:/ncs/v3.2.01/zephyr/arch/arm64/Kconfig"
osource "C:/ncs/v3.2.01/zephyr/arch/arm/Kconfig"
osource "C:/ncs/v3.2.01/zephyr/arch/arc/Kconfig"
```
